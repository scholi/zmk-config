 #include <behaviors.dtsi>
 #include <dt-bindings/zmk/keys.h>
 #include <dt-bindings/zmk/bt.h>
 
 / {
     keymap {
         compatible = "zmk,keymap";
 
         default_layer {
             bindings = <
              &kp F13
              &kp F14
             >;
         };
     };
 };